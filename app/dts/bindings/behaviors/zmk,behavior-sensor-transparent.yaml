## app/dts/bindings/behaviors/zmk,behavior-sensor-transparent.yaml
```yaml
# Copyright (c) 2024 The ZMK Contributors
# SPDX-License-Identifier: MIT

description: Transparent Sensor Binding Behavior

compatible: "zmk,behavior-sensor-transparent"

properties:
  label:
    type: string
    required: false
    deprecated: true
  "#sensor-binding-cells":
    type: int
    required: true
    const: 0
  display-name:
    type: string
    required: false
```

## app/west.yml
```yaml
manifest:
  remotes:
    - name: zephyrproject-rtos
      url-base: https://github.com/zephyrproject-rtos
    - name: zmkfirmware
      url-base: https://github.com/zmkfirmware
    - name: zaiwalinus
      url-base: https://github.com/Zaiwa-linus
  projects:
    - name: zephyr
      remote: zmkfirmware
      revision: v3.5.0+zmk-fixes
      clone-depth: 1
      import:
        name-blocklist:
          - ci-tools
          - hal_altera
          - hal_cypress
          - hal_infineon
          - hal_microchip
          - hal_nxp
          - hal_openisa
          - hal_silabs
          - hal_xtensa
          - hal_st
          - hal_ti
          - loramac-node
          - mcuboot
          - mcumgr
          - net-tools
          - openthread
          - edtt
          - trusted-firmware-m
    - name: nanopb
      revision: 8c60555d6277a0360c876bd85d491fc4fb0cd74a
      path: modules/lib/nanopb
      remote: zmkfirmware
    - name: zmk-studio-messages
      # custom-studio-protocol (cherry-pick from cormoran/zmk-studio-messages 89b81d2)
      remote: zaiwalinus
      revision: v0.3+custom-proto
      path: modules/msgs/zmk-studio-messages
  self:
    west-commands: scripts/west-commands.yml
```
