/*
 * Copyright (c) 2024 The ZMK Contributors
 *
 * SPDX-License-Identifier: MIT
 */

#include <dt-bindings/zmk/behaviors.h>

/ {
    behaviors {
#if ZMK_BEHAVIOR_OMIT(SENSOR_TRANS)
        /omit-if-no-ref/
#endif
        sensor_trans: sensor_transparent {
            compatible = "zmk,behavior-sensor-transparent";
            #sensor-binding-cells = <0>;
            display-name = "Sensor Transparent";
        };
    };
};
